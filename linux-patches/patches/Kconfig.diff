## linux-patches/patches/Kconfig.diff
```kconfig
diff -Naurp a/linux-6.6.38.igel/Kconfig b/linux-6.6.38.igel/Kconfig
--- a/linux-6.6.38.igel/Kconfig	2024-07-09 11:44:29.000000000 +0200
+++ b/linux-6.6.38.igel/Kconfig	2024-08-02 15:41:31.527490917 +0200
@@ -5,6 +5,8 @@
 #
 mainmenu "Linux/$(ARCH) $(KERNELVERSION) Kernel Configuration"
 
+source "IGEL/Kconfig.igel"
+
 source "scripts/Kconfig.include"
 
 source "init/Kconfig"
```
